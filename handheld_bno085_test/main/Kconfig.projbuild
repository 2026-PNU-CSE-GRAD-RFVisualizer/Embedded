## handheld_bno085_test/main/Kconfig.projbuild
```kconfig
menu "BNO085 test configuration"

    config BNO085_I2C_ADDRESS
        hex "BNO085 7-bit I2C address"
        range 0x4A 0x4B
        default 0x4B

    config BNO085_I2C_SPEED_HZ
        int "I2C clock speed (Hz)"
        range 100000 400000
        default 100000

    config BNO085_REPORT_INTERVAL_US
        int "Sensor report interval (microseconds)"
        range 5000 1000000
        default 20000

    choice BNO085_REPORT_TYPE
        prompt "Quaternion report"
        default BNO085_REPORT_GAME_ROTATION_VECTOR

        config BNO085_REPORT_GAME_ROTATION_VECTOR
            bool "Game Rotation Vector (gyro + accelerometer)"

        config BNO085_REPORT_ROTATION_VECTOR
            bool "Rotation Vector (gyro + accelerometer + magnetometer)"
    endchoice

endmenu
```

## handheld_jpeg_stream/main/Kconfig.projbuild
```kconfig
menu "RFVisualizer handheld JPEG stream"

config HANDHELD_LOCAL_BNO085_LCD_TEST
    bool "Run combined BNO085 + local LCD test"
    default n
    select HANDHELD_LOCAL_10FPS_TEST
    help
        Start the BNO085 at 50 Hz in a dedicated task while the embedded
        800x480 LCD animation runs at 10 FPS. Wi-Fi and server streaming are
        skipped because this option selects the local animation test.

config HANDHELD_LOCAL_10FPS_TEST
    bool "Run embedded 10-frame / 10 FPS LCD animation test"
    default n
    help
        Show ten embedded 800x480 baseline JPEG frames at 100 ms intervals
        forever. Wi-Fi and server streaming are skipped while this is enabled.
        Disable it to use the network JPEG stream client.

choice HANDHELD_LOCAL_BNO_DISPLAY_MODE
    prompt "Combined BNO085 test display mode"
    depends on HANDHELD_LOCAL_BNO085_LCD_TEST
    default HANDHELD_LOCAL_3D_TEST

    config HANDHELD_LOCAL_3D_TEST
        bool "Synthetic 3D room driven by full quaternion"
        help
            Render a perspective floor grid and colored wireframe cubes on the
            LCD. The full relative quaternion drives yaw, pitch, and roll, so
            this mode can validate local 3D camera response without a server.

    config HANDHELD_LOCAL_VIEWPORT_TEST
        bool "Synthetic yaw + pitch viewport"
        help
            Build a synthetic panorama in PSRAM and move an 800x480 viewport
            from the latest BNO085 yaw and pitch. This is an offline camera
            response test and does not require Wi-Fi or Graphics.

    config HANDHELD_LOCAL_FRAME_SELECT_TEST
        bool "Legacy yaw-selected JPEG frames"
        help
            Keep the earlier diagnostic behavior where yaw selects one of ten
            embedded animation frames. These frames are not camera viewpoints.
endchoice

config HANDHELD_LCD_PIXEL_CLOCK_MHZ
    int "LCD I80 pixel clock (MHz)"
    range 8 20
    default 16
    help
        16 MHz is intended for the cached 10 FPS test. Reduce this if long
        breadboard wiring causes pixel noise; reducing it also lowers FPS.

config HANDHELD_WIFI_SSID
    string "Wi-Fi SSID"
    default ""
    help
        Local device setting. Do not commit a real SSID.

config HANDHELD_WIFI_PASSWORD
    string "Wi-Fi password"
    default ""
    help
        Local secret. Do not commit a real password or sdkconfig.

config JPEG_STREAM_SERVER_HOST
    string "Image relay server IPv4 address or host name"
    default ""
    help
        Local device setting. Enter the PC running image_relay; do not commit
        a site-specific address.

config JPEG_STREAM_SERVER_PORT
    int "Image relay viewer port"
    range 1 65535
    default 9102

config JPEG_STREAM_MAX_FRAME_BYTES
    int "Maximum image payload bytes"
    range 65536 2097152
    default 524288
    help
        This embedded limit is deliberately lower than the relay's 8 MiB
        protocol limit. It covers JPEG and compressed RGB332 payloads. Two
        buffers of this size are allocated in PSRAM.

config JPEG_STREAM_RX_TIMEOUT_MS
    int "TCP receive timeout (ms)"
    range 1000 30000
    default 5000

config JPEG_STREAM_RX_TASK_STACK
    int "Receiver task stack bytes"
    range 4096 16384
    default 6144

config JPEG_STREAM_SINK_TASK_STACK
    int "Frame sink task stack bytes"
    range 4096 16384
    default 16384
    help
        The RGB332 zlib path calls the ROM miniz inflater, whose decompressor
        state requires substantially more stack than the JPEG-only path.

config BNO085_I2C_ADDRESS
    hex "BNO085 7-bit I2C address"
    range 0x4A 0x4B
    default 0x4B

config BNO085_I2C_SPEED_HZ
    int "BNO085 I2C clock speed (Hz)"
    range 100000 400000
    default 100000

config BNO085_REPORT_INTERVAL_US
    int "BNO085 report interval (microseconds)"
    range 5000 1000000
    default 20000

config BNO085_LCD_REPORT_INTERVAL_US
    int "BNO085 report interval during combined LCD test (microseconds)"
    range 20000 1000000
    default 20000
    depends on HANDHELD_LOCAL_BNO085_LCD_TEST
    help
        LCD I80 frames are split into DMA stripes so BNO085 I2C can run between
        stripes without overlapping the parallel bus. 20000 microseconds keeps
        the production target of 50 Hz. The standalone interval is independent.

config BNO085_INT_POLLING
    bool "Poll BNO085 INT from ImuTask instead of using a GPIO ISR"
    default y if HANDHELD_LOCAL_BNO085_LCD_TEST
    default n
    help
        Keep INT physically connected to GPIO41 but disable its GPIO interrupt.
        The combined local test already calls bno085_service every millisecond,
        and the HAL reads the active-low INT level before each I2C transfer.
        This removes the redundant GPIO ISR while the LCD I80 DMA is active.

choice BNO085_REPORT_TYPE
    prompt "BNO085 quaternion report"
    default BNO085_REPORT_GAME_ROTATION_VECTOR

    config BNO085_REPORT_GAME_ROTATION_VECTOR
        bool "Game Rotation Vector (gyro + accelerometer)"

    config BNO085_REPORT_ROTATION_VECTOR
        bool "Rotation Vector (gyro + accelerometer + magnetometer)"
endchoice

endmenu
```

## handheld_jpeg_stream/sdkconfig.defaults
```kconfig
CONFIG_IDF_TARGET="esp32s3"
CONFIG_ESPTOOLPY_FLASHSIZE_8MB=y
CONFIG_PARTITION_TABLE_SINGLE_APP_LARGE=y
CONFIG_SPIRAM=y
CONFIG_SPIRAM_MODE_OCT=y
CONFIG_SPIRAM_SPEED_80M=y
CONFIG_SPIRAM_USE_MALLOC=y
CONFIG_SPIRAM_MALLOC_RESERVE_INTERNAL=32768
CONFIG_ESP_MAIN_TASK_STACK_SIZE=6144
CONFIG_ESP_SYSTEM_PANIC_PRINT_REBOOT=y
CONFIG_FREERTOS_HZ=1000
CONFIG_ESP_DEFAULT_CPU_FREQ_MHZ_240=y
CONFIG_COMPILER_OPTIMIZATION_PERF=y
CONFIG_JD_USE_ROM=n
CONFIG_JD_FORMAT_RGB565=y
CONFIG_JD_FASTDECODE_32BIT=y
```

## handheld_lcd_test/sdkconfig.defaults
```kconfig
CONFIG_IDF_TARGET="esp32s3"
CONFIG_ESPTOOLPY_FLASHSIZE_16MB=y
CONFIG_PARTITION_TABLE_SINGLE_APP_LARGE=y
CONFIG_SPIRAM=y
CONFIG_SPIRAM_MODE_OCT=y
CONFIG_SPIRAM_SPEED_80M=y
CONFIG_ESP_MAIN_TASK_STACK_SIZE=6144
CONFIG_ESP_SYSTEM_PANIC_PRINT_REBOOT=y
CONFIG_FREERTOS_HZ=1000
```

## rssi_esp32_to_stm32/esp32_node/sdkconfig.defaults
```kconfig
CONFIG_ESP_MAIN_TASK_STACK_SIZE=4096
CONFIG_FREERTOS_HZ=1000
CONFIG_ESP_SYSTEM_PANIC_PRINT_REBOOT=y
CONFIG_XTAL_FREQ_40=y
```
